// Message and scroll speed
char msg[] = " Electronics Workshop 2025 "; // Add trailing space
int scrollspeed = 5; // Lower = faster scroll

// Shift register pins for columns
int clockPin1 = 3; 
int latchPin1 = 2; 
int dataPin1 = 4;

// Shift register pins for rows
int clockPin2 = 7; 
int latchPin2 = 6; 
int dataPin2 = 5;

// Display buffer: 8 rows x 6 zones (6 x 8 columns = 48 columns)
byte bitmap[8][6];

int numZones = sizeof(bitmap[0]);  // 6 zones (48 columns)
int maxZoneIndex = numZones - 1;
int numCols = numZones * 8;

// 5x8 font: standard ASCII subset (A-Z, a-z, 0-9, space)
byte font[][5] = {
  {0,0,0,0,0},        // space
  {0x7E,0x11,0x11,0x11,0x7E}, // A
  {0x7F,0x49,0x49,0x49,0x36}, // B
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  {0x06,0x49,0x49,0x49,0x3E}  // 9
};

int getCharIndex(char c) {
  if (c == ' ') return 0;
  if (c >= 'A' && c <= 'Z') return (c - 'A') + 1;
  if (c >= 'a' && c <= 'z') return (c - 'a') + 27;
  if (c >= '0' && c <= '9') return (c - '0') + 53;
  return 0;
}

void setup() {
  pinMode(latchPin1, OUTPUT); pinMode(clockPin1, OUTPUT); pinMode(dataPin1, OUTPUT);
  pinMode(latchPin2, OUTPUT); pinMode(clockPin2, OUTPUT); pinMode(dataPin2, OUTPUT);

  // Clear bitmap
  for (int r = 0; r < 8; r++) for (int z = 0; z <= maxZoneIndex; z++) bitmap[r][z] = 0;
}

void RefreshDisplay() {
  for (int row = 0; row < 8; row++) {
    byte rowbit = 1 << row;
    digitalWrite(latchPin2, LOW);
    shiftOut(dataPin2, clockPin2, MSBFIRST, rowbit); // Select row

    digitalWrite(latchPin1, LOW);
    for (int zone = maxZoneIndex; zone >= 0; zone--) {
      shiftOut(dataPin1, clockPin1, MSBFIRST, bitmap[row][zone]);
    }
    digitalWrite(latchPin1, HIGH);
    digitalWrite(latchPin2, HIGH);

    delayMicroseconds(300); // Adjust for brightness
  }
}

void Plot(int col, int row, bool isOn) {
  int zone = col / 8;
  int colBitIndex = col % 8;
  byte colBit = 1 << colBitIndex;
  if (isOn)
    bitmap[row][zone] |= colBit;
  else
    bitmap[row][zone] &= ~colBit;
}

void XProcess() {
  int msgLength = strlen(msg);
  for (int charIndex = 0; charIndex < msgLength; charIndex++) {
    int index = getCharIndex(msg[charIndex]);

    for (int col = 0; col < 7; col++) {
      for (int row = 0; row < 8; row++) {
        bool isOn = false;
        if (col < 5)
          isOn = bitRead(font[index][col], row);
        Plot(numCols - 1, row, isOn);
      }

      for (int refresh = 0; refresh < scrollspeed; refresh++)
        RefreshDisplay();

      for (int row = 0; row < 8; row++) {
        for (int zone = 0; zone < numZones; zone++) {
          bitmap[row][zone] >>= 1;
          if (zone < maxZoneIndex)
            bitWrite(bitmap[row][zone], 7, bitRead(bitmap[row][zone + 1], 0));
        }
      }
    }
  }
}

void loop() {
  XProcess();
}
